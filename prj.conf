## CMakeLists.txt
```
#
# Copyright (c) 2018 Nordic Semiconductor
#
# SPDX-License-Identifier: LicenseRef-Nordic-5-Clause
#
cmake_minimum_required(VERSION 3.13.1)

find_package(Zephyr REQUIRED HINTS $ENV{ZEPHYR_BASE})
project(NONE)

# NORDIC SDK APP START
target_sources (app PRIVATE src/main.c)
target_sources (app PRIVATE src/seggerDebug.c)
target_sources (app PRIVATE src/parseHelper.c)
# NORDIC SDK APP END

zephyr_library_include_directories(${CMAKE_CURRENT_SOURCE_DIR})
```

## prj.conf
```kconfig
# Config logger

CONFIG_LOG=y
CONFIG_USE_SEGGER_RTT=y
CONFIG_LOG_BACKEND_RTT=y
CONFIG_LOG_BACKEND_UART=n
CONFIG_NEWLIB_LIBC=y
```

## src/main.c
```c
/*
 * J-Link RTT viewer debug helper
 * set "Send on enter"
 * set "End of line" CR or LF and set Segger_start('\n') or Segger_start('\r');
 */

#include "seggerDebug.h"
#include <logging/log.h>

#define LOG_MODULE_NAME SeggerDebug
LOG_MODULE_REGISTER(LOG_MODULE_NAME);

void call_1(char *com, int *data, uint8_t num)
{
    LOG_INF("call_1 feedback \"%s\"", log_strdup(com));
    LOG_INF("Params:");
    for(uint8_t i = 0; i < num; i++)
        LOG_INF("param %d = %d", i, *(data + i));
    LOG_INF("You can do something here");
}

void call_2(char *com, int *data, uint8_t num)
{
    LOG_INF("call_2 feedback \"%s\"", log_strdup(com));
    LOG_INF("Params:");
    for(uint8_t i = 0; i < num; i++)
        LOG_INF("param %d = %d", i, *(data + i));
    LOG_INF("You can do something here");
}

void call_3(char *com, int *data, uint8_t num)
{
    LOG_INF("call_3 feedback \"%s\"", log_strdup(com));
    LOG_INF("Params:");
    for(uint8_t i = 0; i < num; i++)
        LOG_INF("param %d = %d", i, *(data + i));
    LOG_INF("You can do something here");
}

void main() 
{
    int err;

    LOG_INF("* J-Link RTT viewer debug helper");
    LOG_INF("* set \"Send on enter\"");
    LOG_INF("* set \"End of line\" CR or LF and set Segger_start('\\n') or Segger_start('\\r') ");
/* Set callback handler for keyword "calibration"
*/
    err = Segger_init(&call_1, "end");

/* Set callback handler for keyword "reset"
*/
    err = Segger_init(&call_2, "reset");

/* Set callback handler for keyword "start"
*/
    err = Segger_init(&call_3, "start");

/* Check for overflow
*/
    if(err) LOG_ERR("overflow of the number of keywords");

/*Start RTT debug for '\n' end char of line
 *Set separator char for data stream
*/
    Segger_start('\n', ' ');
}
```

## src/parseHelper.c
```c
#include "parseHelper.h"
#include "math.h"
#include <string.h>

void ArrayRevers(void *inputArrayVoid, uint8_t len, uint8_t type_size)
{
    int *inputArray = inputArrayVoid;
    int temp_data_array[len];
    for(uint8_t i = 0; i < len; i++)
        temp_data_array[i] = *(inputArray + len - i - 1);
    memcpy(inputArray, temp_data_array, len * type_size);
}

uint8_t ParseCharArray(char *input_array, char *compare_char_array, int *data_array, uint8_t *data_number, char data_separator)
{
    if(memcmp(input_array, compare_char_array, strlen(compare_char_array)) == 0)
    {
        uint8_t digit = 0;
        for(uint8_t x = strlen(input_array); x > 0; x--)
        {
            if(input_array[x] > 47 && input_array[x] < 58)
            {
                *(data_array + *data_number) += (int) (*(input_array + x) - 48) * pow(10, digit);
                digit++;
            }
            if(*(input_array + x) == data_separator && digit != 0) {digit = 0; (*(data_number))++;}
        }
        ArrayRevers(data_array, *(data_number), (uint8_t) sizeof(data_array));
        return 1;
    } 
    else return 0;
}
```

## src/parseHelper.h
```c
#include <stdint.h>
#include <inttypes.h>

void ArrayRevers(void *inputArrayVoid, uint8_t len, uint8_t type_size);
uint8_t ParseCharArray(char *input_array, char *compare_char_array, int *data_array, uint8_t *data_number, char data_separator);
```

## src/seggerDebug.c
```c
#include "seggerDebug.h"
#include "parseHelper.h"

char input[comm_max_length] = {0};
uint8_t len = 0;
uint8_t prog_num = 0;
char prog_call[comm_max_count][comm_max_length] = {0};
void *prog[comm_max_count] = {NULL};
char end_of_line, separator;

int Segger_init(void *program_, const char *call)
{
    if(prog_num == comm_max_count) return -1;
    memcpy(&prog_call[prog_num][0], call, strlen(call));
    prog[prog_num] = program_;
    prog_num++;
    return 0;
}

void Segger_Pool()
{
    int r = SEGGER_RTT_GetKey();
    if(r != -1) 
    {
        while(r != -1 && r != end_of_line)
        {
            input[len] = r;
            len++;
            r = SEGGER_RTT_GetKey();
        }
        if(r == end_of_line || len == comm_max_length) 
        {
            uint8_t params_num = 0;
            int segger_params[data_max_count] = {0};
            for(uint8_t i = 0; i < prog_num; i++)
                if(ParseCharArray(input, &prog_call[i][0], segger_params, &params_num, separator))
                {
                    void (*fun_ptr)(char*, int*, uint8_t) = prog[i];
                    (*fun_ptr)(input, segger_params, params_num);
                }
            memset(input, 0, len);
            len = 0;
        }
    }
}

K_WORK_DEFINE(Segger_work, Segger_Pool);

void Segger_timer_handler(struct k_timer *dummy)
{
    k_work_submit(&Segger_work);
}

K_TIMER_DEFINE(Segger_timer, Segger_timer_handler, NULL);

void Segger_start(char end_of_line_, char separator_)
{
    end_of_line = end_of_line_;
    separator = separator_;
    k_timer_start(&Segger_timer, K_MSEC(200), K_MSEC(200));
}
```

## src/seggerDebug.h
```c
#include "SEGGER_RTT.h"
#include <string.h>

#define comm_max_length    100
#define comm_max_count     10
#define data_max_count     20

int Segger_init(void *program_, const char *call);

void Segger_Pool();

void Segger_timer_handler(struct k_timer *dummy);

void Segger_start(char end_of_line_, char separator_);
```
